## boards/shields/ten44/Kconfig.defconfig
```kconfig
if SHIELD_TEN44_LEFT

config ZMK_KEYBOARD_NAME
    default "Ten44"

config ZMK_SPLIT_ROLE_CENTRAL
    default y

endif

if SHIELD_TEN44_LEFT || SHIELD_TEN44_RIGHT

config ZMK_SPLIT
    default y

endif
```

## boards/shields/ten44/Kconfig.shield
```kconfig
config SHIELD_TEN44_LEFT
    def_bool $(shields_list_contains,ten44_left)

config SHIELD_TEN44_RIGHT
    def_bool $(shields_list_contains,ten44_right)
```

## config/west.yml
```yaml
manifest:
  remotes:
    - name: zmkfirmware
      url-base: https://github.com/zmkfirmware
  projects:
    - name: zmk
      revision: main
      remote: zmkfirmware
      import: app/west.yml
  self:
    path: config
```
