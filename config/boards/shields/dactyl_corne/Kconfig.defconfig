## config/boards/shields/dactyl_corne/Kconfig.defconfig
```kconfig
if SHIELD_CYGNUS_LEFT

config ZMK_KEYBOARD_NAME
    default "Cygnus_4x6"

config ZMK_SPLIT_ROLE_CENTRAL
    default y

endif

if SHIELD_CYGNUS_LEFT || SHIELD_CYGNUS_RIGHT

config ZMK_SPLIT
    default y

endif
```

## config/boards/shields/ten44/Kconfig.defconfig
```kconfig
if SHIELD_DACTYL_CORNE_LEFT

config ZMK_KEYBOARD_NAME
    default "Dactyl Corne"

config ZMK_SPLIT_ROLE_CENTRAL
    default y

endif

if SHIELD_DACTYL_CORNE_LEFT || SHIELD_DACTYL_CORNE_RIGHT

config ZMK_SPLIT
    default y

endif
```

## config/boards/shields/ten44/Kconfig.shield
```kconfig
config SHIELD_DACTYL_CORNE_LEFT
    def_bool $(shields_list_contains,dactyl_corne_left)

config SHIELD_DACTYL_CORNE_RIGHT
    def_bool $(shields_list_contains,dactyl_corne_right)
```

## config/boards/shields/totem_step/Kconfig.defconfig
```kconfig
if SHIELD_TOTEM_STEP_LEFT

config ZMK_KEYBOARD_NAME
    default "Totem Step"

config ZMK_SPLIT_ROLE_CENTRAL
    default y

endif

if SHIELD_TOTEM_STEP_LEFT || SHIELD_TOTEM_STEP_RIGHT

config ZMK_SPLIT
    default y

endif
```

## config/boards/shields/totem_step/Kconfig.shield
```kconfig
config SHIELD_TOTEM_STEP_LEFT
    def_bool $(shields_list_contains,totem_step_left)

config SHIELD_TOTEM_STEP_RIGHT
    def_bool $(shields_list_contains,totem_step_right)
```
